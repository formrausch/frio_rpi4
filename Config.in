## Config.in
```kconfig
# Add project-specific packages for Buildroot here
#
# If these are non-proprietary, please consider contributing them back to
# Nerves or Buildroot.
#
source "$NERVES_DEFCONFIG_DIR/package/ili9881d/Config.in"
source "$NERVES_DEFCONFIG_DIR/package/reterminal-dm/Config.in"
source "$NERVES_DEFCONFIG_DIR/package/mipi-dsi/Config.in"
source "$NERVES_DEFCONFIG_DIR/package/ch34x/Config.in"
source "$NERVES_DEFCONFIG_DIR/package/ltr30x/Config.in"
source "$NERVES_DEFCONFIG_DIR/package/rtc-pcf8563w/Config.in"
```

## package/ch34x/Config.in
```kconfig
config BR2_PACKAGE_CH34X
	bool "ch34x"
	help
          CH34x



comment "ch34x needs a Linux kernel and libiio to be built"
	depends on !BR2_LINUX_KERNEL
	depends on !BR2_LIBIIO
```

## package/ili9881d/Config.in
```kconfig
config BR2_PACKAGE_ILI9881D
	bool "ili9881d"
	help
	  ili9881d display driver

          https://github.com/Seeed-Studio/seeed-linux-dtoverlays/tree/master/modules/ili9881d

comment "ili9881d needs a Linux kernel to be built"
	depends on !BR2_LINUX_KERNEL
```

## package/ltr30x/Config.in
```kconfig
config BR2_PACKAGE_LTR30X
	bool "ltr30x"
	help
	  ltr30x

          https://github.com/Seeed-Studio/seeed-linux-dtoverlays

comment "ltr30x needs a Linux kernel to be built"
	depends on !BR2_LINUX_KERNEL
```

## package/reterminal-dm/Config.in
```kconfig
menuconfig BR2_PACKAGE_RETERMINAL_DM
	bool "reterminal-dm"
	select BR2_PACKAGE_HOST_DTC
	help
	  Reterminal DM DTS files that may be useful on Nerves systems.
```

## package/rtc-pcf8563w/Config.in
```kconfig
config BR2_PACKAGE_RTC_PCF8563W
	bool "rtc-pcf8563w"
	help
	  rtc-pcf8563w

          https://github.com/Seeed-Studio/seeed-linux-dtoverlays

comment "rtc-pcf8563w needs a Linux kernel to be built"
	depends on !BR2_LINUX_KERNEL
```
